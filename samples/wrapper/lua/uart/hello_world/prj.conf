## CMakeLists.txt
```
# SPDX-License-Identifier: Apache-2.0

cmake_minimum_required(VERSION 3.20.0)

set(ZBOOK_ROOT ${CMAKE_CURRENT_SOURCE_DIR}/../../../../..)
set(BOARD_ROOT ${ZBOOK_ROOT})

if(NOT DEFINED BOARD)
	set(BOARD zbook/rp2350b/m33)
endif()

include($ENV{ZEPHYR_BASE}/modules/lua_zephyr/luaz.cmake)
luaz_define_source_thread(src/uart_sample.lua)

find_package(Zephyr REQUIRED HINTS $ENV{ZEPHYR_BASE})
project(uart_sample)

target_include_directories(app PRIVATE
	${ZBOOK_ROOT}/interface/includes
	${ZBOOK_ROOT}/wrappers/lua/include
)

# This sample builds the zbook lua wrapper directly, outside of zbook's own
# Kconfig tree, so CONFIG_ZBOOK_LUA_UART is never defined by menuconfig.
target_compile_definitions(app PRIVATE CONFIG_ZBOOK_LUA_UART=1)

target_sources(app PRIVATE
	${ZBOOK_ROOT}/interface/src/protocols/zbook_uart.c
	${ZBOOK_ROOT}/wrappers/lua/src/lua_zbook.c
	${ZBOOK_ROOT}/wrappers/lua/src/protocols/zbook_lua_uart.c
	src/setup.c
)

luaz_generate_threads()
```

## sample.yaml
```
sample:
  name: UART Lua wrapper
tests:
  sample.zbook.wrapper.lua.uart:
    harness: console
    harness_config:
      type: multi_line
      ordered: true
      regex:
        - "uart.cfg  err=0"
        - "uart.init err=0"
        - "uart.write err=0"
    tags: zbook lua uart
    platform_allow:
      - zbook/rp2350b/m33
```

## prj.conf
```kconfig
CONFIG_SERIAL=y
CONFIG_UART_USE_RUNTIME_CONFIGURE=y

# Sample has no need for a filesystem; the board default pulls in the
# fatfs vendor sources, which this workspace hasn't fetched.
CONFIG_FAT_FILESYSTEM_ELM=n

CONFIG_LUA=y

CONFIG_BOOT_BANNER=n
CONFIG_LOG=y
CONFIG_LUA_ZEPHYR_LOG_LEVEL_DBG=y

# No UART wiring available on this board (debug-probe uart0 bridge is dead,
# uart1 needs an external adapter on P20/P21) -- route printk through ARM
# semihosting instead, so the sample's output is visible via the debugger
# without any physical UART link. Requires the debug session to run with
# semihosting enabled (e.g. openocd's "arm semihosting enable").
CONFIG_SEMIHOST=y
CONFIG_LOG_BACKEND_SEMIHOST=y
CONFIG_LOG_PRINTK=y

CONFIG_ASSERT=y
CONFIG_MAIN_STACK_SIZE=4096

CONFIG_SYS_HEAP_RUNTIME_STATS=y
CONFIG_INIT_STACKS=y
CONFIG_THREAD_STACK_INFO=y
CONFIG_SYS_HEAP_ARRAY_SIZE=1
CONFIG_THREAD_NAME=y
```

## src/setup.c
```c
 /*******************************************************************
 * @file setup.c
 *
 * @brief Initializes the `zbook` Lua library for the uart_sample thread.
 * @author João Matheus Nascimento Dias (joao.dias@edge.ufal.br)
 * @version 0.1
 * @date 21/08/2026
 *
 * @copyright Copyright (c) 2026
 *
 *******************************************************************/
#include <lauxlib.h>
#include <lua.h>
#include <zbook_lua.h>

/** @brief Weak hook run before uart_sample.lua: registers zbook.* in package.preload. */
int uart_sample_lua_setup(lua_State *L)
{
	luaL_getsubtable(L, LUA_REGISTRYINDEX, LUA_PRELOAD_TABLE);
	lua_pushcfunction(L, luaopen_zbook);
	lua_setfield(L, -2, "zbook");
	lua_pop(L, 1);

	return 0;
}
```
