## Kconfig
```kconfig
menu "Zephyr"
source "Kconfig.zephyr"
endmenu

source "wrappers/lua/Kconfig"

module = MAIN
module-str = main
source "subsys/logging/Kconfig.template.log_config"

rsource "interface/Kconfig"
rsource "wrappers/lua/Kconfig"
```

## boards/zbook/Kconfig.zbook
```kconfig
config BOARD_ZBOOK
    bool
	select SOC_RP2350B_M33

config SOC
	default "rp2350b"
```

## boards/zbook/board.yml
```yaml
# SPDX-License-Identifier: Apache-2.0
#
# Copyright (c) 2024, Centro de Inovacao EDGE

board:
  full_name: zbook
  name: zbook
  vendor: edge
  socs:
    - name: rp2350b
      variants:
        - name: mcuboot
          cpucluster: m33
```

## boards/zbook/zbook_rp2350b_m33_defconfig
```kconfig
CONFIG_BUILD_OUTPUT_HEX=y
CONFIG_BUILD_OUTPUT_UF2=y
CONFIG_CLOCK_CONTROL=y
CONFIG_CONSOLE=y
CONFIG_GPIO=y

CONFIG_SPI=y

CONFIG_PINCTRL=y
CONFIG_RESET=y
CONFIG_SERIAL=y
CONFIG_UART_CONSOLE=y
CONFIG_UART_INTERRUPT_DRIVEN=y
CONFIG_USE_DT_CODE_PARTITION=y
CONFIG_LOG=y
CONFIG_FPU=y

CONFIG_ADC=y
CONFIG_VOLTAGE_DIVIDER=y

CONFIG_LED_STRIP=y

CONFIG_DISK_ACCESS=y
CONFIG_DISK_DRIVERS=y

CONFIG_SPI=y

CONFIG_SDHC=y

# FATFS
CONFIG_FILE_SYSTEM=y
CONFIG_FAT_FILESYSTEM_ELM=y
```

## interface/Kconfig
```kconfig
config ZBOOK_WRAPPER_LUA
	bool "Prepare ZBook interface for the Lua wrapper"
	help
	  Master switch: turns on, by default, the ZBook interface protocol
	  modules that have a Lua binding (SPI, UART, I2C, ...).

config ZBOOK_SPI
	bool "ZBook SPI protocol interface"
	select SPI
	default y if ZBOOK_WRAPPER_LUA
	help
	  Enable zbook_spi_init/write/read, a pure-C passthrough over the
	  Zephyr SPI driver bound to the zbook_spi devicetree node.
```

## samples/wrapper/lua/uart/build/Kconfig/Kconfig.lua_thread.uart_sample
```kconfig
config UART_SAMPLE_LUA_THREAD_STACK_SIZE
    int "uart_sample Lua thread stack size"
    default LUA_THREAD_STACK_SIZE
    help
      Stack size for the uart_sample Lua thread.

config UART_SAMPLE_LUA_THREAD_HEAP_SIZE
    int "uart_sample Lua thread heap size"
    default LUA_THREAD_HEAP_SIZE
    help
      Heap size for the uart_sample Lua thread.

config UART_SAMPLE_LUA_THREAD_PRIORITY
    int "uart_sample Lua thread priority"
    default LUA_THREAD_PRIORITY
    help
      Priority for the uart_sample Lua thread.
```

## samples/wrapper/lua/uart/build/Kconfig/Kconfig.modules
```kconfig
menu "lua (/home/joaomatheusnd/repo/ufal/zbook_workspace/zephyr/modules/lua_zephyr)"
osource "/home/joaomatheusnd/repo/ufal/zbook_workspace/zephyr/modules/lua_zephyr/Kconfig.luaz"
config ZEPHYR_LUA_MODULE
	bool
	default y
endmenu
menu "cmsis_6 (/home/joaomatheusnd/repo/ufal/zbook_workspace/modules/hal/cmsis_6)"
osource "$(ZEPHYR_CMSIS_6_KCONFIG)"
config ZEPHYR_CMSIS_6_MODULE
	bool
	default y
endmenu
menu "hal_rpi_pico (/home/joaomatheusnd/repo/ufal/zbook_workspace/modules/hal/rpi_pico)"
osource "$(ZEPHYR_HAL_RPI_PICO_KCONFIG)"
config ZEPHYR_HAL_RPI_PICO_MODULE
	bool
	default y
endmenu
```

## samples/wrapper/lua/uart/build/Kconfig/Kconfig.shield.defconfig
```kconfig
osource "/home/joaomatheusnd/repo/ufal/zbook_workspace/zbook/samples/wrapper/lua/uart/hello_world/../../../../../boards/shields/*/Kconfig.defconfig"
```

## samples/wrapper/lua/uart/build/Kconfig/Kconfig.sysbuild.modules
```kconfig
config ZEPHYR_LUA_MODULE
   bool
   default y
config ZEPHYR_CMSIS_6_MODULE
   bool
   default y
config ZEPHYR_HAL_RPI_PICO_MODULE
   bool
   default y
```

## samples/wrapper/lua/uart/build/Kconfig/arch/Kconfig
```kconfig
# Load Zephyr Arch Kconfig descriptions.
osource "/home/joaomatheusnd/repo/ufal/zbook_workspace/zephyr/arch/rx/Kconfig"
osource "/home/joaomatheusnd/repo/ufal/zbook_workspace/zephyr/arch/x86/Kconfig"
osource "/home/joaomatheusnd/repo/ufal/zbook_workspace/zephyr/arch/xtensa/Kconfig"
osource "/home/joaomatheusnd/repo/ufal/zbook_workspace/zephyr/arch/sparc/Kconfig"
osource "/home/joaomatheusnd/repo/ufal/zbook_workspace/zephyr/arch/riscv/Kconfig"
osource "/home/joaomatheusnd/repo/ufal/zbook_workspace/zephyr/arch/posix/Kconfig"
osource "/home/joaomatheusnd/repo/ufal/zbook_workspace/zephyr/arch/openrisc/Kconfig"
osource "/home/joaomatheusnd/repo/ufal/zbook_workspace/zephyr/arch/mips/Kconfig"
osource "/home/joaomatheusnd/repo/ufal/zbook_workspace/zephyr/arch/arm64/Kconfig"
osource "/home/joaomatheusnd/repo/ufal/zbook_workspace/zephyr/arch/arm/Kconfig"
osource "/home/joaomatheusnd/repo/ufal/zbook_workspace/zephyr/arch/arc/Kconfig"
```

## samples/wrapper/lua/uart/build/Kconfig/boards/Kconfig.defconfig
```kconfig
# Load Zephyr board defconfig descriptions.
osource "/home/joaomatheusnd/repo/ufal/zbook_workspace/zbook/boards/zbook/Kconfig.defconfig"
```

## samples/wrapper/lua/uart/build/Kconfig/boards/Kconfig.sysbuild.tmp
```kconfig
# Load Sysbuild board Kconfig descriptions.
osource "/home/joaomatheusnd/repo/ufal/zbook_workspace/zbook/boards/zbook/Kconfig.sysbuild"
```

## samples/wrapper/lua/uart/build/Kconfig/boards/Kconfig.tmp
```kconfig
# Load Zephyr board Kconfig descriptions.
osource "/home/joaomatheusnd/repo/ufal/zbook_workspace/zbook/boards/zbook/Kconfig"
```

## west.yml
```yaml
manifest:
  version: "0.13"

  remotes:
    - name: zephyrproject-rtos
      url-base: https://github.com/zephyrproject-rtos

    - name: rodrigopex
      url-base: https://github.com/rodrigopex

  projects:
    - name: zephyr
      remote: zephyrproject-rtos
      revision: v4.4.0
      west-commands: scripts/west-commands.yml
      import:
        name-allowlist:
          - hal_rpi_pico
          - picolib
          - cmsis_6
          - fatfs

    - name: lua_zephyr
      remote: rodrigopex
      revision: main
      submodules: true
      path: zephyr/modules/lua_zephyr
```

## wrappers/lua/Kconfig
```kconfig
config LUA_ZBOOK_SPI
	bool "ZBook Lua binding for SPI"
	default y
	depends on ZBOOK_SPI && LUA
	help
	  Expose zbook.protocols.spi (init/write/read) to Lua scripts.
# SPDX-License-Identifier: Apache-2.0
#
# Copyright (c) Centro de Inovacao EDGE

menu "ZBook language wrappers"
	depends on LUA

config ZBOOK_LUA_UART
	bool "Lua binding for zbook_uart"
	default y
	help
	  Expose zbook_uart_* to Lua scripts as zbook.protocols.uart.

endmenu
```
