## CMakeLists.txt
```
cmake_minimum_required(VERSION 3.20.0)

get_filename_component(ZBOOK_ROOT "${CMAKE_CURRENT_SOURCE_DIR}/../../../../.." ABSOLUTE)

set(BOARD_ROOT ${ZBOOK_ROOT})

if(NOT DEFINED BOARD)
    set(BOARD zbook/rp2350b/m33)
endif()

include($ENV{ZEPHYR_BASE}/modules/lua_zephyr/luaz.cmake)
luaz_define_source_thread(src/lua_uart.lua)

find_package(Zephyr REQUIRED HINTS $ENV{ZEPHYR_BASE})

project(zbook_lua_uart_sample)

file(GLOB_RECURSE ZBOOK_INTERFACE_SOURCES ${ZBOOK_ROOT}/interface/src/*.c)
target_sources(app PRIVATE ${ZBOOK_INTERFACE_SOURCES})
target_include_directories(app PRIVATE ${ZBOOK_ROOT}/interface/includes)

file(GLOB_RECURSE ZBOOK_LUA_WRAPPER_SOURCES ${ZBOOK_ROOT}/wrappers/lua/src/*.c)
target_sources(app PRIVATE ${ZBOOK_LUA_WRAPPER_SOURCES})
target_include_directories(app PRIVATE ${ZBOOK_ROOT}/wrappers/lua/include)

# Gathers ZBOOK_LUA_PROTOCOL_DEFINE() entries into one contiguous,
# STRUCT_SECTION_FOREACH()-iterable region (see zbook_lua_protocol.h).
zephyr_linker_sources(DATA_SECTIONS ${ZBOOK_ROOT}/wrappers/lua/zbook_lua_protocol.ld)

target_sources(app PRIVATE ${CMAKE_CURRENT_SOURCE_DIR}/src/zbook_lua_setup.c)

luaz_generate_threads()
```

## sample.yaml
```
sample:
  name: ZBook Lua UART
tests:
  sample.zbook.lua_uart:
    harness: console
    harness_config:
      type: multi_line
      ordered: true
      regex:
        - "uart.cfg  err=0"
        - "uart.init err=0"
        - "uart.write err=0"
    platform_allow: zbook/rp2350b/m33
    integration_platforms:
      - zbook/rp2350b/m33
    tags:
      - zbook
      - lua
      - uart
```

## prj.conf
```kconfig
CONFIG_ZBOOK_WRAPPER_LUA=y
CONFIG_LUA=y

CONFIG_SERIAL=y
CONFIG_UART_USE_RUNTIME_CONFIGURE=y

# Sample has no need for a filesystem; the board default pulls in the
# fatfs vendor sources, which this workspace hasn't fetched.
CONFIG_FAT_FILESYSTEM_ELM=n

CONFIG_BOOT_BANNER=n
CONFIG_LOG=y
CONFIG_LUA_ZEPHYR_LOG_LEVEL_DBG=y

CONFIG_SEMIHOST=y
CONFIG_LOG_BACKEND_SEMIHOST=y
CONFIG_LOG_PRINTK=y

CONFIG_ASSERT=y
CONFIG_MAIN_STACK_SIZE=4096

CONFIG_SYS_HEAP_RUNTIME_STATS=y
CONFIG_INIT_STACKS=y
CONFIG_THREAD_STACK_INFO=y
CONFIG_SYS_HEAP_ARRAY_SIZE=1
CONFIG_THREAD_NAME=y
```

## boards/zbook_rp2350b_m33.overlay
```dts
/*
 * Point zbook-uart at uart0 (console wire) so this sample's output is
 * visible in the same terminal as the shell/log, instead of uart1 which
 * is wired to the wifi shield on P20/P21.
 */

/ {
	aliases {
		zbook-uart = &uart0;
	};
};
```

## src/zbook_lua_setup.c
```c
 /*******************************************************************
 * @file zbook_lua_setup.c
 *
 * @brief Registers the `zbook` Lua library for the lua_uart sample thread.
 * @author João Matheus Nascimento Dias (joao.dias@edge.ufal.br)
 * @version 0.1
 * @date 21/08/2026
 *
 * @copyright Copyright (c) 2026
 *
 *******************************************************************/

#include <lauxlib.h>
#include <zbook_lua.h>

int lua_uart_lua_setup(lua_State *L)
{
	luaL_requiref(L, "zbook", luaopen_zbook, 1);
	lua_pop(L, 1);

	return 0;
}
```
