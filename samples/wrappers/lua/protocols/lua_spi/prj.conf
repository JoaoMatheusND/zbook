## CMakeLists.txt
```
cmake_minimum_required(VERSION 3.20.0)

get_filename_component(ZBOOK_ROOT "${CMAKE_CURRENT_SOURCE_DIR}/../../../../.." ABSOLUTE)

set(BOARD_ROOT ${ZBOOK_ROOT})

if(NOT DEFINED BOARD)
    set(BOARD zbook/rp2350b/m33)
endif()

include($ENV{ZEPHYR_BASE}/modules/lua_zephyr/luaz.cmake)
luaz_define_source_thread(src/lua_spi.lua)

find_package(Zephyr REQUIRED HINTS $ENV{ZEPHYR_BASE})

project(zbook_lua_spi_sample)

file(GLOB_RECURSE ZBOOK_INTERFACE_SOURCES ${ZBOOK_ROOT}/interface/src/*.c)
target_sources(app PRIVATE ${ZBOOK_INTERFACE_SOURCES})
target_include_directories(app PRIVATE ${ZBOOK_ROOT}/interface/includes)

file(GLOB_RECURSE ZBOOK_LUA_WRAPPER_SOURCES ${ZBOOK_ROOT}/wrappers/lua/src/*.c)
target_sources(app PRIVATE ${ZBOOK_LUA_WRAPPER_SOURCES})
target_include_directories(app PRIVATE ${ZBOOK_ROOT}/wrappers/lua/include)

target_sources(app PRIVATE ${CMAKE_CURRENT_SOURCE_DIR}/src/zbook_lua_setup.c)

luaz_generate_threads()
```

## Kconfig
```
menu "Zephyr"
source "Kconfig.zephyr"
endmenu

module = MAIN
module-str = main
source "subsys/logging/Kconfig.template.log_config"

rsource "../../../../../interface/Kconfig"
rsource "../../../../../wrappers/lua/Kconfig"
```

## sample.yaml
```
sample:
  name: ZBook Lua SPI
tests:
  sample.zbook.lua_spi:
    build_only: true
    platform_allow: zbook/rp2350b/m33
    integration_platforms:
      - zbook/rp2350b/m33
    tags:
      - zbook
      - lua
      - spi
```

## prj.conf
```kconfig
CONFIG_ZBOOK_WRAPPER_LUA=y
CONFIG_LUA=y
CONFIG_LUA_LIB_STRING=y

CONFIG_SYS_HEAP_RUNTIME_STATS=y
CONFIG_INIT_STACKS=y
CONFIG_THREAD_STACK_INFO=y
```

## boards/zbook_rp2350b_m33.overlay
```dts
&spibb0 {
	status = "disabled";
};
```

## src/zbook_lua_setup.c
```c
/**
 * @file zbook_lua_setup.c
 * @brief Registers the `zbook` Lua library for the lua_spi sample thread.
 */

#include <lauxlib.h>
#include <zbook_lua.h>

int lua_spi_lua_setup(lua_State *L)
{
	luaL_requiref(L, "zbook", luaopen_zbook, 1);
	lua_pop(L, 1);

	return 0;
}
```
